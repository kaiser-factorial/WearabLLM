## v3_WAVESHARE/firmware/main/Kconfig.projbuild
```kconfig
menu "WearabLLM v3"

config WEARABLLM_WIFI_SSID
    string "Wi-Fi SSID"
    default ""
    help
        Wi-Fi network used by the ESP32-S3 to reach the bridge.

config WEARABLLM_WIFI_PASSWORD
    string "Wi-Fi password"
    default ""

config WEARABLLM_WIFI_BSSID
    string "Wi-Fi BSSID/AP MAC (optional)"
    default ""
    help
        Optional access point MAC address, formatted like 02:00:00:00:00:01.
        Leave blank for normal SSID roaming. Set this only when you need the
        ESP32-S3 to connect to one specific AP that shares the configured SSID.

config WEARABLLM_BRIDGE_URL
    string "Bridge query URL"
    default "http://192.168.1.10:8765/v1/query"
    help
        Local bridge endpoint that receives audio/wav and returns JSON.

config WEARABLLM_BRIDGE_AUTH_TOKEN
    string "Bridge device token (extractable)"
    default ""
    help
        Optional token sent as X-WearabLLM-Device-Token to the bridge query and
        TTS endpoints. Required by the hosted agent. It can be recovered from a
        firmware image, so use a rotatable device-specific secret.

config WEARABLLM_DEVICE_ID
    string "WearabLLM device ID"
    default "wearabllm-esp32"
    help
        Stable non-secret ID sent to the hosted bridge with each request. It
        lets the shared agent identify the source body in recent conversation
        records. Give future wearables distinct IDs.

config WEARABLLM_DIRECT_OPENAI
    bool "Call OpenAI directly from firmware (API key is extractable)"
    default n
    help
        Removes the runtime bridge dependency by embedding a project API key in
        the firmware image. Anyone who can read the image can recover the key.

config WEARABLLM_OPENAI_API_KEY
    string "OpenAI project API key"
    default ""
    depends on WEARABLLM_DIRECT_OPENAI

config WEARABLLM_OPENAI_STT_MODEL
    string "OpenAI transcription model"
    default "gpt-4o-transcribe"
    depends on WEARABLLM_DIRECT_OPENAI

config WEARABLLM_OPENAI_LLM_MODEL
    string "OpenAI response model"
    default "gpt-5.4-mini"
    depends on WEARABLLM_DIRECT_OPENAI

config WEARABLLM_OPENAI_TTS_MODEL
    string "OpenAI TTS model"
    default "gpt-4o-mini-tts"
    depends on WEARABLLM_DIRECT_OPENAI

config WEARABLLM_OPENAI_TTS_VOICE
    string "OpenAI TTS voice"
    default "verse"
    depends on WEARABLLM_DIRECT_OPENAI

config WEARABLLM_TRANSCRIPT_LOG_ENABLED
    bool "Upload transcripts to a private HTTPS endpoint"
    default n
    help
        Queues successful interactions for best-effort background upload.
        Device interaction and TTS continue if logging is unavailable.

config WEARABLLM_TRANSCRIPT_LOG_URL
    string "Transcript log HTTPS URL"
    default ""
    depends on WEARABLLM_TRANSCRIPT_LOG_ENABLED

config WEARABLLM_TRANSCRIPT_DEVICE_ID
    string "Transcript log device ID"
    default "wearabllm-esp32"
    depends on WEARABLLM_TRANSCRIPT_LOG_ENABLED

config WEARABLLM_TRANSCRIPT_DEVICE_TOKEN
    string "Transcript log device token (extractable)"
    default ""
    depends on WEARABLLM_TRANSCRIPT_LOG_ENABLED
    help
        Shared secret checked by the transcript endpoint. Like the OpenAI key,
        it can be recovered from a firmware image and must be rotatable.

config WEARABLLM_WIFI_CONNECT_TIMEOUT_MS
    int "Wi-Fi connect wait timeout ms"
    range 1000 120000
    default 15000
    help
        Maximum time to wait for Wi-Fi before showing an error for one
        push-to-talk interaction. The station will keep reconnecting in the
        background.

config WEARABLLM_PTT_GPIO
    int "Push-to-talk GPIO"
    default 0
    help
        Phase-1 default uses the BOOT button GPIO. Move this to a better free
        GPIO or an expander-backed user button once the board button map is
        finalized.

config WEARABLLM_PTT_ACTIVE_LEVEL
    int "Push-to-talk active level"
    range 0 1
    default 0
    help
        GPIO level that means the push-to-talk button is held. Use 0 for the
        BOOT button or a button wired from GPIO to GND with a pull-up. Use 1
        for a button wired from GPIO to 3V3 with a pull-down.

config WEARABLLM_PTT_DEBOUNCE_MS
    int "Push-to-talk debounce ms"
    range 0 250
    default 35
    help
        GPIO level must remain stable for this long before a press/release is
        accepted. Increase this for noisy external pushbuttons or long
        perfboard leads; set to 0 to use raw GPIO polling.

choice WEARABLLM_PTT_PULL_MODE
    prompt "Push-to-talk GPIO pull mode"
    default WEARABLLM_PTT_PULL_UP
    help
        Internal bias for the push-to-talk input. For a simple external button,
        use pull-up when the button shorts GPIO to GND, or pull-down when it
        shorts GPIO to 3V3. Use no pull only when the circuit already has an
        external resistor.

config WEARABLLM_PTT_PULL_NONE
    bool "No internal pull"

config WEARABLLM_PTT_PULL_UP
    bool "Internal pull-up"

config WEARABLLM_PTT_PULL_DOWN
    bool "Internal pull-down"

endchoice

config WEARABLLM_AUDIO_MAX_SECONDS
    int "Maximum push-to-talk capture seconds"
    range 1 20
    default 6
    help
        Maximum WAV duration captured while the push-to-talk button is held.
        Keeps accidental long holds from creating very large bridge uploads.

config WEARABLLM_AUDIO_MIN_CAPTURE_MS
    int "Minimum push-to-talk capture ms"
    range 0 2000
    default 250
    help
        Minimum WAV duration captured after the button is pressed, even if the
        button is released immediately. This debounces taps and avoids empty
        or too-short WAV uploads during first hardware bring-up.

config WEARABLLM_LED_GPIO
    int "RGB ring data GPIO"
    default 38
    help
        Waveshare demo defines the 7-LED WS2812 ring on GPIO38.

config WEARABLLM_LED_COUNT
    int "RGB ring LED count"
    default 7

config WEARABLLM_LED_SELF_TEST_ON_BOOT
    bool "Run RGB ring command self-test on boot"
    default n
    help
        Runs the 9 WearabLLM command animations once during boot, before Wi-Fi
        and audio bring-up. Useful for checking the ring without bridge/API
        dependencies. Leave disabled for normal interaction tests.

config WEARABLLM_AUDIO_OUT_ENABLED
    bool "Enable ES8311 speaker output"
    default n
    help
        Enables the Waveshare board speaker codec for short earcon bring-up.
        Leave disabled until microphone capture and the bridge loop are stable.

config WEARABLLM_AUDIO_OUT_VOLUME
    int "Speaker output volume"
    range 0 100
    default 45
    depends on WEARABLLM_AUDIO_OUT_ENABLED
    help
        Initial ES8311 output volume used for earcon/TTS bring-up.

config WEARABLLM_TTS_ENABLED
    bool "Fetch and play bridge TTS WAV"
    default n
    depends on WEARABLLM_AUDIO_OUT_ENABLED
    help
        Experimental phase-2 path. After a bridge response, POST the reply text
        to the TTS URL, download a small audio/wav response, and play it through
        the ES8311 speaker path. Keep disabled until speaker output is verified.

config WEARABLLM_TTS_URL
    string "Bridge TTS URL"
    default "http://192.168.1.10:8765/v1/tts"
    depends on WEARABLLM_TTS_ENABLED
    help
        Local bridge endpoint that receives JSON {"text": "..."} and returns
        audio/wav. Usually this is the same host/port as WEARABLLM_BRIDGE_URL.

config WEARABLLM_TTS_MAX_BYTES
    int "Maximum TTS WAV bytes"
    default 131072
    depends on WEARABLLM_TTS_ENABLED || WEARABLLM_DIRECT_OPENAI
    help
        Maximum audio/wav response to buffer in RAM for phase-2 playback.

config WEARABLLM_DISPLAY_ENABLED
    bool "Enable SPI TFT display"
    default n
    help
        Keep disabled until the LED/mic/bridge loop is verified and the
        perfboard TFT wiring has passed continuity checks.

config WEARABLLM_DISPLAY_SELF_TEST_ON_BOOT
    bool "Run TFT display wiring self-test on boot"
    default n
    depends on WEARABLLM_DISPLAY_ENABLED
    help
        Draws color bands and the configured TFT pin map for a short boot-time
        wiring check, then returns to the normal READY screen.

config WEARABLLM_TFT_SCLK_GPIO
    int "TFT SCLK GPIO"
    default 4

config WEARABLLM_TFT_MOSI_GPIO
    int "TFT MOSI GPIO"
    default 9

config WEARABLLM_TFT_CS_GPIO
    int "TFT CS GPIO"
    default 3

config WEARABLLM_TFT_DC_GPIO
    int "TFT DC GPIO"
    default 7

config WEARABLLM_TFT_RST_GPIO
    int "TFT RST GPIO"
    default 6

config WEARABLLM_TFT_BL_GPIO
    int "TFT backlight GPIO"
    default 5
    help
        If the backlight is tied directly to 3V3, leave display disabled or
        ignore this value in the eventual driver.

config WEARABLLM_TFT_WIDTH
    int "TFT width"
    default 128

config WEARABLLM_TFT_HEIGHT
    int "TFT height"
    default 160

config WEARABLLM_TFT_X_OFFSET
    int "TFT X offset"
    default 0
    help
        Some ST7735 breakout variants need a 1 or 2 pixel column offset.

config WEARABLLM_TFT_Y_OFFSET
    int "TFT Y offset"
    default 0
    help
        Some ST7735 breakout variants need a row offset, often 0, 1, or 24.

config WEARABLLM_TFT_INVERT_COLORS
    bool "Invert TFT colors"
    default y
    help
        Many ST7735 modules look correct with display inversion enabled.

endmenu
```

## v3_WAVESHARE/firmware/sdkconfig.defaults
```kconfig
CONFIG_IDF_TARGET="esp32s3"
CONFIG_ESPTOOLPY_FLASHSIZE_16MB=y
CONFIG_SPIRAM=y
CONFIG_SPIRAM_MODE_OCT=y
CONFIG_SPIRAM_SPEED_80M=y
CONFIG_PARTITION_TABLE_CUSTOM=y
CONFIG_PARTITION_TABLE_CUSTOM_FILENAME="partitions.csv"
CONFIG_SR_WN_WN9_HIESP=y
CONFIG_FREERTOS_HZ=1000
CONFIG_LOG_DEFAULT_LEVEL_INFO=y
CONFIG_MBEDTLS_CERTIFICATE_BUNDLE=y
```

## vC_WAVESHARE/firmware/sdkconfig.defaults
```kconfig
CONFIG_IDF_TARGET="esp32s3"
CONFIG_ESPTOOLPY_FLASHSIZE_16MB=y
CONFIG_SPIRAM=y
CONFIG_SPIRAM_MODE_OCT=y
CONFIG_SPIRAM_SPEED_80M=y
CONFIG_PARTITION_TABLE_CUSTOM=y
CONFIG_PARTITION_TABLE_CUSTOM_FILENAME="partitions.csv"
CONFIG_SR_WN_WN9_HIESP=y
CONFIG_FREERTOS_HZ=1000
CONFIG_LOG_DEFAULT_LEVEL_INFO=y
CONFIG_MBEDTLS_CERTIFICATE_BUNDLE=y
CONFIG_WEARABLLM_TFT_SCLK_GPIO=6
CONFIG_WEARABLLM_TFT_MOSI_GPIO=7
CONFIG_WEARABLLM_TFT_CS_GPIO=9
CONFIG_WEARABLLM_TFT_DC_GPIO=4
CONFIG_WEARABLLM_TFT_RST_GPIO=3
CONFIG_WEARABLLM_TFT_BL_GPIO=5
CONFIG_WEARABLLM_TFT_WIDTH=320
CONFIG_WEARABLLM_TFT_HEIGHT=240
CONFIG_WEARABLLM_TFT_ROTATION=3
CONFIG_WEARABLLM_TFT_SAFE_LEFT_PERCENT=0
CONFIG_WEARABLLM_TFT_X_OFFSET=0
CONFIG_WEARABLLM_TFT_Y_OFFSET=0
CONFIG_WEARABLLM_TFT_INVERT_COLORS=y
```
